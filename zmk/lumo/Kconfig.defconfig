## zmk/lumo/Kconfig.defconfig
```kconfig
if SHIELD_LUMO_LEFT

config ZMK_KEYBOARD_NAME
    default "LuMo"

config ZMK_SPLIT_ROLE_CENTRAL
    default y

endif

if SHIELD_LUMO_LEFT || SHIELD_LUMO_RIGHT

config ZMK_SPLIT
    default y


endif
```

## zmk/lumo/Kconfig.shield
```kconfig
   

config SHIELD_LUMO_LEFT
    def_bool $(shields_list_contains,lumo_left)

config SHIELD_LUMO_RIGHT
    def_bool $(shields_list_contains,lumo_right)
    
```
